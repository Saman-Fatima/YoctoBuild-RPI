## sources/build/conf/bblayers.conf
```bitbake
# POKY_BBLAYERS_CONF_VERSION is increased each time build/conf/bblayers.conf
# changes incompatibly
POKY_BBLAYERS_CONF_VERSION = "2"

BBPATH = "${TOPDIR}"
BBFILES ?= ""

BBLAYERS ?= " \
  /home/ser2/build/raspberrypi/sources/poky/meta \
  /home/ser2/build/raspberrypi/sources/poky/meta-poky \
  /home/ser2/build/raspberrypi/sources/poky/meta-yocto-bsp \
  "
```
